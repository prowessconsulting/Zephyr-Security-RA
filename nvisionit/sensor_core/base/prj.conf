## prj.conf
```kconfig
CONFIG_PRINTK=y
CONFIG_STDOUT_CONSOLE=y

CONFIG_SYS_CLOCK_TICKS_PER_SEC=1000

CONFIG_IPM=y
CONFIG_IPM_QUARK_SE=y
CONFIG_IPM_CONSOLE_SENDER=y
CONFIG_CONSOLE=y
CONFIG_SERIAL=n
CONFIG_NANO_TIMEOUTS=y
```

## src/main.c
```c
/* main_arc.c - main source file for ARC app */

/*
 * Copyright (c) 2016 Intel Corporation.
 *
 * Licensed under the Apache License, Version 2.0 (the "License");
 * you may not use this file except in compliance with the License.
 * You may obtain a copy of the License at
 *
 *     http://www.apache.org/licenses/LICENSE-2.0
 *
 * Unless required by applicable law or agreed to in writing, software
 * distributed under the License is distributed on an "AS IS" BASIS,
 * WITHOUT WARRANTIES OR CONDITIONS OF ANY KIND, either express or implied.
 * See the License for the specific language governing permissions and
 * limitations under the License.
 */

#include <zephyr.h>

#include <ipm.h>
#include <ipm/ipm_quark_se.h>
#include <init.h>
#include <device.h>
#include <misc/byteorder.h>
#include <stdio.h>
#include <string.h>
#include <misc/printk.h>

#include <sensor_ipm_ids.h>

/* measure every 2ms */
#define INTERVAL 	200
#define SLEEPTICKS MSEC(INTERVAL)


/* ID of IPM channel */
#define HRS_ID		99

QUARK_SE_IPM_DEFINE(sensor_ipm, 0, QUARK_SE_IPM_OUTBOUND);


void main(void)
{
	struct device *ipm;
	struct nano_timer timer;
	uint32_t data[2] = {0, 0};
	uint8_t count = 90;
	int ret;

	nano_timer_init(&timer, data);

	/* Initialize the IPM */
  ipm = device_get_binding("sensor_ipm");
	if (!ipm) {
    printk("IPM: Device not found.\n");
  }

  	sensor_digital_start(ipm);


	while (1) {

		/* send data over ipm to x86 side */
		if (ipm) {
			ret = ipm_send(ipm, 1, HRS_ID, &count, sizeof(count));
			if (ret) {
				printk("Failed to send IPM message, error (%d)\n", ret);
			}
		}

		count++;
		if (count >=160)
		{
			count = 90;
		}

		nano_timer_start(&timer, SLEEPTICKS);
		nano_timer_test(&timer, TICKS_UNLIMITED);
	}
}
```

## include/sensor_digital.h
```c
/* Developed by nVisionIT */

#include <zephyr.h>

#include <device.h>
#include <gpio.h>
#include <misc/util.h>

#include <ipm.h>
#include <ipm/ipm_quark_se.h>

#include <sensor_ipm_ids.h>

#ifndef SENSOR_DIGITAL
#define SENSOR_DIGITAL

// This Pin maps to A0
#define GPIO_OUT_PIN	2
// This Pin maps to A1
#define GPIO_INT_PIN	3
#define GPIO_NAME	"GPIO_SS_"

#if defined(CONFIG_GPIO_DW_0)
#define GPIO_DRV_NAME CONFIG_GPIO_DW_0_NAME
#elif defined(CONFIG_GPIO_QMSI_0)
#define GPIO_DRV_NAME CONFIG_GPIO_QMSI_0_NAME
#elif defined(CONFIG_GPIO_ATMEL_SAM3)
#define GPIO_DRV_NAME CONFIG_GPIO_ATMEL_SAM3_PORTB_DEV_NAME
#else
#define GPIO_DRV_NAME "GPIO_0"
#endif

static struct gpio_callback sensor_digital_gpio_cb;

struct device* ipm; 

/**
 * @brief The GPIO callback that handles activation events.
 * @param port Pointer to the device structure for the driver instance.
 * @param cb GPIO callback structure.
 * @param pins The GPIO pins that have been activated.
 *
 * Note: enables to add as many callback as needed on the same port.
 */
void sensor_digital_gpio_callback(struct device *port, struct gpio_callback *cb, uint32_t pins);

/**
* @brief Start the digital sensor monitor service 
*/
void sensor_digital_start(struct device* ipm);

#endif
```

## include/sensor_ipm_ids.h
```c
/* Developed by nVisionIT */

#ifndef SENSOR_IPM_IDS
#define SENSOR_IPM_IDS

#define IPM_ID_COMMON   0xBEEF0000
#define IPM_ID_POWER    (0x1 & IPM_ID_COMMON)
#define IPM_ID_PIR      (0x2 & IPM_ID_COMMON)
#define IPM_ID_MAGBREAK (0x3 & IPM_ID_COMMON)
#define IPM_ID_HRS      (0x4 & IPM_ID_COMMON)
#define IPM_ID_GYRO     (0x5 & IPM_ID_COMMON)
#define IPM_ID_TEMP     (0x6 & IPM_ID_COMMON)

#endif
```

## src/sensor_digital.c
```c
/* Digital Sensors Code */
#include <sensor_digital.h>

void sensor_digital_gpio_callback(struct device *port, struct gpio_callback *cb, uint32_t pins)
{
	int ret;

	ret = ipm_send(ipm, 1, IPM_ID_PIR, &pins, sizeof(pins));
    if (ret) {
        printk("Failed to send IPM message, error (%d)\n", ret);
    }
}

void sensor_digital_start(struct device* ipm){
    struct device *gpio_dev;
	int ret;
	int toggle = 1;

	gpio_dev = device_get_binding(GPIO_DRV_NAME);
	if (!gpio_dev) {
		printk("Cannot find %s!\n", GPIO_DRV_NAME);
		return;
	}

	/* Setup GPIO output */
	ret = gpio_pin_configure(gpio_dev, GPIO_OUT_PIN, (GPIO_DIR_OUT));
	if (ret) {
		printk("Error configuring " GPIO_NAME "%d!\n", GPIO_OUT_PIN);
	}

	/* Setup GPIO input, and triggers on rising edge. */
	ret = gpio_pin_configure(gpio_dev, GPIO_INT_PIN, (GPIO_DIR_IN | GPIO_INT | GPIO_INT_EDGE | GPIO_INT_ACTIVE_HIGH | GPIO_INT_DEBOUNCE));
	
    if (ret) {
		printk("Error configuring " GPIO_NAME "%d!\n", GPIO_INT_PIN);
	}

	gpio_init_callback(&sensor_digital_gpio_cb, sensor_digital_gpio_callback, BIT(GPIO_INT_PIN));

	ret = gpio_add_callback(gpio_dev, &sensor_digital_gpio_cb);
	if (ret) {
		printk("Cannot setup callback!\n");
	}

	ret = gpio_pin_enable_callback(gpio_dev, GPIO_INT_PIN);
	if (ret) {
		printk("Error enabling callback!\n");
	}    
    
    printk("Toggling " GPIO_NAME "%d\n", GPIO_OUT_PIN);

    ret = gpio_pin_write(gpio_dev, GPIO_OUT_PIN, toggle);
    if (ret) {
        printk("Error set " GPIO_NAME "%d!\n", GPIO_OUT_PIN);
    }
}
```
